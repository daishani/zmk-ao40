#include <dt-bindings/zmk/matrix_transform.h>

/ {
	chosen {
		zmk,matrix_transform = &default_transform;
	};

	sensors {
		compatible = "zmk,keymap-sensors";
		sensors = <&left_encoder &right_encoder>;
                triggers-per-rotation = <20>;
	};
};
