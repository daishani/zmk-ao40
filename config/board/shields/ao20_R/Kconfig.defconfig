## config/boards/shields/ao40/Kconfig.defconfig
```kconfig
if SHIELD_AO40_DONGLE

config ZMK_KEYBOARD_NAME
        default "ao40 Dongle"

config ZMK_SPLIT_BLE_ROLE_CENTRAL
	default y
	
config ZMK_USB
	default y

endif

if SHIELD_AO40_LEFT || SHIELD_AO40_RIGHT || SHIELD_AO40_DONGLE

config ZMK_SPLIT
	default y

config ZMK_BLE
	default y
	
endif
```

## config/west.yml
```yaml
manifest:
  remotes:
    - name: zmkfirmware
      url-base: https://github.com/zmkfirmware
  projects:
    - name: zmk
      remote: zmkfirmware
      revision: v0.13.2
      import: app/west.yml
  self:
    path: config
```
